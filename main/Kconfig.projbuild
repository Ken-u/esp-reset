## main/Kconfig.projbuild
```kconfig
menu "ESP Reset"
config RESET_OUTPUT_GPIO_1
    int "Channel 1 GPIO (active high)"
    range 0 48 if IDF_TARGET_ESP32S3
    range 0 10 if IDF_TARGET_ESP32C3
    default 4 if IDF_TARGET_ESP32S3
    default 3 if IDF_TARGET_ESP32C3
    help
        Drives an external active-high MOSFET or isolated dry-contact switch.
        Never wire this GPIO directly across an unknown button.
config RESET_OUTPUT_GPIO_2
    int "Channel 2 GPIO (active high)"
    range 0 48 if IDF_TARGET_ESP32S3
    range 0 10 if IDF_TARGET_ESP32C3
    default 5 if IDF_TARGET_ESP32S3
    default 4 if IDF_TARGET_ESP32C3
config RESET_OUTPUT_GPIO_3
    int "Channel 3 GPIO (active high)"
    range 0 48 if IDF_TARGET_ESP32S3
    range 0 10 if IDF_TARGET_ESP32C3
    default 6 if IDF_TARGET_ESP32S3
    default 5 if IDF_TARGET_ESP32C3
config RESET_RECOVERY_GPIO
    int "Onboard BOOT button GPIO (hold 5 seconds to clear Wi-Fi)"
    default 0 if IDF_TARGET_ESP32S3
    default 9 if IDF_TARGET_ESP32C3
endmenu
```

## sdkconfig.defaults
```kconfig
CONFIG_PARTITION_TABLE_CUSTOM=y
CONFIG_PARTITION_TABLE_CUSTOM_FILENAME="partitions.csv"
CONFIG_BOOTLOADER_APP_ROLLBACK_ENABLE=y
# CONFIG_ESP_CONSOLE_UART_DEFAULT is not set
CONFIG_ESP_CONSOLE_USB_SERIAL_JTAG=y
CONFIG_ESP_CONSOLE_SECONDARY_NONE=y
CONFIG_ESP_MAIN_TASK_STACK_SIZE=6144
CONFIG_HTTPD_MAX_REQ_HDR_LEN=1024
CONFIG_HTTPD_MAX_URI_LEN=128
CONFIG_COMPILER_OPTIMIZATION_SIZE=y
CONFIG_ESPTOOLPY_FLASHMODE_DIO=y
CONFIG_ESPTOOLPY_FLASHFREQ_40M=y
```
